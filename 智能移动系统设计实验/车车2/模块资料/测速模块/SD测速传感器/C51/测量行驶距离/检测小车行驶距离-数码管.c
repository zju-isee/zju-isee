/******************************************************************************************
程序名：小车行使距离-数码管
编写人：Yayi
论坛：rtrobot.org　　　                                                
/******************************************************************************************/

#include <STC12C5A60S2.H>//头文件

sbit IN1=P1^0;
sbit IN2=P1^1;
sbit IN3=P1^2;
sbit IN4=P1^3;
/******************************************************************************************
使用数组对数码管预先定义
/*****************************************************************************************/ 
unsigned char part_date[10]= {	0xC0,/*0*/
        			0xF9,/*1*/
        			0xA4,/*2*/
       				0xB0,/*3*/
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				0x90,/*9*/	};

unsigned int motor1=0;	 //计左电机码盘脉冲值
unsigned int motor2=0;	 //计右电机码盘脉冲值

void Forward(void)
{
        IN1=1;
        IN2=0;
        IN3=0;
        IN4=1;
}

/*********************************************************************************************
外部中断INT0、INT1初始化函数
/********************************************************************************************/
void INT_init (void)
{
	EA = 1;			//中断总开关  
	EX0 = 1; 		//允许外部中断0中断
	IT0 = 1; 		//1：下沿触发  0：低电平触发
	EX1 = 1;		//允许外部中断1中断
	IT1	= 1;		//1：下沿触发  0：低电平触发
}

/********************************************************************************************
//延迟函数
/********************************************************************************************/
void DELAY_MS (unsigned int a)
{
	unsigned int i;
	while( a-- != 0)
	{
		for(i = 0; i < 600; i++);
	}
}

/*********************************************************************************************
主程序
/********************************************************************************************/
void main(void)
{				
	INT_init();
	Forward();
	while (1)
	{
		P0=part_date[motor1%10];	//对P0端口进行赋值，95%10=5
		P2=0x07;			//对P2口进行赋值，显示第四位
		DELAY_MS(1);			//延迟1毫秒
		P0=part_date[motor1/10];	//对P0端口进行赋值，95/10=9
		P2=0x0b;			//对P2口进行赋值，显示第三位
		DELAY_MS(1);			//延迟1毫秒
		P0=part_date[motor2%10];	//对P0端口进行赋值，95%10=5
		P2=0x0d;			//对P2口进行赋值，显示第二位
		DELAY_MS(1);			//延迟1毫秒
		P0=part_date[motor2/10];	//对P0端口进行赋值，95/10=9
		P2=0x0e;			//对P2口进行赋值，显示第一位
		DELAY_MS(1);			//延迟1毫秒
	}
}

/*********************************************************************************************
外部中断INT0计算电机1的脉冲
/********************************************************************************************/
void intersvr1(void) interrupt 0 using 1
{	
	motor1++;	
	if(motor1>=99)
		motor1=0;	
}
/*********************************************************************************************
外部中断INT1计算电机2的脉冲
/********************************************************************************************/
void intersvr2(void) interrupt 2 using 3
{
	motor2++;
	if(motor2>=99)
		motor2=0;
}